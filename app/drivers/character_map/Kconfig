## app/drivers/character_map/Kconfig
```kconfig
# Copyright (c) 2023 The ZMK Contributors
# SPDX-License-Identifier: MIT

config ZMK_CHARACTER_MAP
    bool
    default y
    depends on DT_HAS_ZMK_CHARACTER_MAP_ENABLED
```

## app/module/drivers/Kconfig
```kconfig
# Copyright (c) 2020 The ZMK Contributors
# SPDX-License-Identifier: MIT

rsource "character_map/Kconfig"
rsource "gpio/Kconfig"
rsource "kscan/Kconfig"
rsource "sensor/Kconfig"
rsource "display/Kconfig"
```
